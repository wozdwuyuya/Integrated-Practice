## application/samples/Kconfig
```kconfig
#===============================================================================
# @brief    Kconfig file.
# Copyright (c) @CompanyNameMagicTag 2023-2023. All rights reserved.
#===============================================================================

config ENABLE_PERIPHERAL_SAMPLE
    bool
    prompt "Enable the Sample of peripheral."
    default n
    depends on SAMPLE_ENABLE
    help
        This option means enable the sample of peripheral.

if ENABLE_PERIPHERAL_SAMPLE
osource "application/samples/peripheral/Kconfig"
endif

config ENABLE_WIFI_SAMPLE
    bool
    prompt "Enable the Sample of WIFI."
    default n
    depends on SAMPLE_ENABLE
    help
        This option means enable the sample of WIFI.

if ENABLE_WIFI_SAMPLE
osource "application/samples/wifi/Kconfig"
endif

config ENABLE_PRODUCTS_SAMPLE
    bool
    prompt "Enable the Sample of products."
    default n
    depends on SAMPLE_ENABLE
    help
        This option means enable the sample of products.
if ENABLE_PRODUCTS_SAMPLE
osource "application/samples/products/Kconfig"
endif



config ENABLE_QRSWORK_SAMPLE
    bool
    prompt "Enable the Sample of qrswork."
    default n
    depends on SAMPLE_ENABLE
    help
        This option means enable the sample of qrswork (heart rate monitor with SLE).

if ENABLE_QRSWORK_SAMPLE
choice
    prompt "Select qrswork application type"
    default SAMPLE_SUPPORT_QRSWORK
    help
        Select whether to build qrswork server or qrswork client.

config SAMPLE_SUPPORT_QRSWORK
    bool "qrswork Server (Heart rate sensor with SLE sender)"
    help
        Enable qrswork as SLE server, which reads heart rate sensor and sends data to clients.

config SAMPLE_SUPPORT_QRSWORK_CLIENT
    bool "qrswork Client (Heart rate data receiver)"
    help
        Enable qrswork client, which receives heart rate data via SLE and outputs to UART.
endchoice

if SAMPLE_SUPPORT_QRSWORK
osource "application/samples/qrswork/Kconfig"
endif

if SAMPLE_SUPPORT_QRSWORK_CLIENT
osource "application/samples/qrswork_client/Kconfig"
endif

endif
```

## application/samples/qrswork/Kconfig
```kconfig
#===============================================================================
# @brief    Kconfig file for qrswork
#===============================================================================

choice
    prompt "Select qrswork type"
    default SAMPLE_SUPPORT_QRSWORK_SERVER
    depends on SAMPLE_SUPPORT_QRSWORK
    config SAMPLE_SUPPORT_QRSWORK_SERVER
        bool "Enable qrswork Server (Heart rate sender)."
        help
            Enable qrswork as SLE server, which sends heart rate data to clients.
endchoice

config SUPPORT_SLE_PERIPHERAL
    bool
    default y if (SAMPLE_SUPPORT_QRSWORK_SERVER)

config QRSWORK_MOCK_HARDWARE
    bool "Enable mock hardware mode (use fake sensor data for debugging)"
    default y
    help
        When enabled, health_monitor_main uses simulated sensor data instead
        of reading from real MAX30102/MPU6050 hardware. Useful for development
        without physical sensors connected. Disable for production builds.
```

## application/samples/qrswork_client/Kconfig
```kconfig
#===============================================================================
# @brief    Kconfig file for qrswork client
#===============================================================================

config QRSWORK_UART_BUS
    int
    prompt "Set the UART BUS for qrswork client."
    default 0
    depends on SAMPLE_SUPPORT_QRSWORK_CLIENT
    help
        This option sets the UART BUS for the qrswork client.

config QRSWORK_UART_TXD_PIN
    int
    prompt "Choose UART TXD pin for qrswork client."
    depends on SAMPLE_SUPPORT_QRSWORK_CLIENT
    default 17

config QRSWORK_UART_RXD_PIN
    int
    prompt "Choose UART RXD pin for qrswork client."
    depends on SAMPLE_SUPPORT_QRSWORK_CLIENT
    default 18

config QRSWORK_NORTHBOUND_ENABLE
    bool
    prompt "Enable WiFi northbound uplink for qrswork client."
    default y
    depends on SAMPLE_SUPPORT_QRSWORK_CLIENT
    help
        Enable WiFi STA mode and UDP uplink to a northbound computer/server.

config QRSWORK_WIFI_SSID
    string
    prompt "WiFi SSID for northbound uplink."
    default "test"
    depends on QRSWORK_NORTHBOUND_ENABLE
    help
        SSID of the WiFi network that the board connects to in STA mode.

config QRSWORK_WIFI_PSK
    string
    prompt "WiFi password for northbound uplink."
    default "0987654321"
    depends on QRSWORK_NORTHBOUND_ENABLE
    help
        Password of the WiFi network that the board connects to.

config QRSWORK_SERVER_IP
    string
    prompt "Northbound server IPv4 address."
    default "192.168.1.175"
    depends on QRSWORK_NORTHBOUND_ENABLE
    help
        IPv4 address of the computer/server receiving qrswork UDP data.

config QRSWORK_SERVER_PORT
    int
    prompt "Northbound server UDP port."
    default 8888
    range 1 65535
    depends on QRSWORK_NORTHBOUND_ENABLE
    help
        UDP port of the computer/server receiving qrswork data.

config SUPPORT_SLE_CENTRAL
    bool
    default y if SAMPLE_SUPPORT_QRSWORK_CLIENT
```
